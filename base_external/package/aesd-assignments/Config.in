## base_external/package/aesd-assignments/Config.in
```kconfig
config BR2_PACKAGE_AESD_ASSIGNMENTS
	bool "aesd-socket"
	help
	  Includes the socket application and runs it initially on system startup.
```
